## Documentation/devicetree/bindings/sram/ti,omap4-sar-ram.yaml
```yaml
# SPDX-License-Identifier: GPL-2.0-only OR BSD-2-Clause
%YAML 1.2
---
$id: http://devicetree.org/schemas/sram/ti,omap4-sar-ram.yaml#
$schema: http://devicetree.org/meta-schemas/core.yaml#

title: TI OMAP4 SAR RAM

maintainers:
  - Ryan Brue <ryanbrue.dev@gmail.com>

description:
  The SAR (save and restore) RAM of OMAP4 SoCs is on-chip RAM in the wakeup
  domain. It keeps its contents across a warm reset, so boot firmware and the
  kernel can use it to pass state, for example a reboot mode for the
  bootloader.

properties:
  compatible:
    items:
      - const: ti,omap4-sar-ram
      - const: syscon
      - const: simple-mfd

  reg:
    maxItems: 1

  reboot-mode:
    type: object
    description:
      Reboot mode for the bootloader, for example a syscon-reboot-mode node
      or a device specific one such as samsung,espresso-reboot-mode.

required:
  - compatible
  - reg

additionalProperties: false

examples:
  - |
    sram@4a326000 {
        compatible = "ti,omap4-sar-ram", "syscon", "simple-mfd";
        reg = <0x4a326000 0x1000>;

        reboot-mode {
            compatible = "syscon-reboot-mode";
            offset = <0xff8>;
            mode-normal = <0x1>;
            mode-recovery = <0x2>;
            mode-download = <0x20>;
        };
    };
```

## drivers/net/wireless/mediatek/mt76/mt6630/Kconfig
```kconfig
# SPDX-License-Identifier: BSD-3-Clause-Clear
config MT6630S
	tristate "MediaTek MT6630 (SDIO) support"
	select MT76_CORE
	select MT76_SDIO
	depends on MAC80211
	depends on MMC
	imply BT_MTKSDIO
	help
	  This adds support for the WLAN function of the MediaTek MT6630
	  combo chip on SDIO. The chip's Bluetooth function loads the ROM
	  patch the WLAN firmware needs, so the WLAN function waits for
	  BT_MTKSDIO to bind first.

	  To compile this driver as a module, choose M here.
```

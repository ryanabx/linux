## Documentation/devicetree/bindings/extcon/samsung,p30-connector.yaml
```yaml
# SPDX-License-Identifier: (GPL-2.0-only OR BSD-2-Clause)
%YAML 1.2
---
$id: http://devicetree.org/schemas/extcon/samsung,p30-connector.yaml#
$schema: http://devicetree.org/meta-schemas/core.yaml#

title: Samsung 30-pin accessory connector

maintainers:
  - Nuke <retuhmadam2010@proton.me>

description: |
  The Samsung 30-pin accessory connector used on Galaxy Tab tablets
  identifies accessories through an analog ACCESSORY_ID signal measured
  by an external ADC. A separate GPIO indicates attachment and removal.

  USB OTG adapters are reported through the extcon subsystem as USB host
  connections.

properties:
  compatible:
    const: samsung,p30-connector

  detect-gpios:
    maxItems: 1
    description:
      GPIO indicating whether an accessory is attached.

  io-channels:
    maxItems: 1
    description:
      ADC channel used to measure the ACCESSORY_ID signal.

  io-channel-names:
    const: accessory-id

required:
  - compatible
  - detect-gpios
  - io-channels
  - io-channel-names

additionalProperties: false

examples:
  - |
    #include <dt-bindings/gpio/gpio.h>

    connector {
        compatible = "samsung,p30-connector";
        detect-gpios = <&gpio1 31 GPIO_ACTIVE_LOW>;
        io-channels = <&adc 3>;
        io-channel-names = "accessory-id";
    };
```

## Documentation/devicetree/bindings/power/reset/samsung,espresso-reboot-mode.yaml
```yaml
# SPDX-License-Identifier: (GPL-2.0-only OR BSD-2-Clause)
%YAML 1.2
---
$id: http://devicetree.org/schemas/power/reset/samsung,espresso-reboot-mode.yaml#
$schema: http://devicetree.org/meta-schemas/core.yaml#

title: Samsung Galaxy Tab 2 bootloader reboot mode

maintainers:
  - Ryan Brue <ryanbrue.dev@gmail.com>

description:
  The bootloader of the Samsung Galaxy Tab 2 (espresso, OMAP4430) reads the
  boot mode from the OMAP4 SAR RAM, from the word at offset 0xff8. It uses
  that flag only if the word at 0xff4 holds the tag "RESE" (0x45534552);
  at every boot it leaves a different tag there. The node is a child of
  the SAR RAM syscon, and the mode-* values are the flags.

allOf:
  - $ref: reboot-mode.yaml#

properties:
  compatible:
    const: samsung,espresso-reboot-mode

patternProperties:
  "^mode-.*$":
    maxItems: 1

required:
  - compatible

unevaluatedProperties: false

examples:
  - |
    reboot-mode {
        compatible = "samsung,espresso-reboot-mode";
        mode-normal = <0x1>;
        mode-recovery = <0x2>;
        mode-download = <0x20>;
    };
...
```

## Documentation/devicetree/bindings/power/supply/mediatek,mt6397-battery.yaml
```yaml
# SPDX-License-Identifier: (GPL-2.0-only OR BSD-2-Clause)
%YAML 1.2
---
$id: http://devicetree.org/schemas/power/supply/mediatek,mt6397-battery.yaml#
$schema: http://devicetree.org/meta-schemas/core.yaml#

title: MediaTek MT6397 PMIC fuel gauge

maintainers:
  - Ryan Brue <ryanbrue.dev@gmail.com>

description:
  The MT6397 PMIC contains a fuel gauge (FGADC) that measures the battery
  current across a board-provided sense resistor and integrates it in
  hardware. The driver runs MediaTek's battery-meter algorithm on top of it,
  which needs the pack characterised at several temperatures. The
  open-circuit-voltage curves and the temperatures themselves are the generic
  ocv-capacity-table-N and ocv-capacity-celsius of the monitored battery; the
  internal resistance along each curve and the capacity at each temperature
  have no generic property and are given here, indexed the same way. The pack
  temperature comes from a thermal zone named "battery-thermal", and the state
  of charge is carried over a reboot in a byte of the PMIC RTC's spare
  storage. The gauge is a child of the PMIC node.

allOf:
  - $ref: power-supply.yaml#

properties:
  compatible:
    const: mediatek,mt6397-battery

  io-channels:
    items:
      - description:
          Battery voltage, from the PMIC AUXADC's ISENSE channel, which is
          the one on the pack when the charger sits in the power path.

  io-channel-names:
    items:
      - const: voltage

  monitored-battery: true

  nvmem-cells:
    items:
      - description:
          One byte of storage that survives a reboot, which the meter seeds
          itself from so that the reported capacity does not jump. The MT6397
          RTC offers its spare bytes for this.

  nvmem-cell-names:
    items:
      - const: state-of-charge

  power-supplies:
    description: The charger, whose status re-anchors the gauge at full.

  shunt-resistor-micro-ohms:
    description: Value of the current sense resistor fitted on the board.
    enum: [10000, 20000]

  mediatek,car-tune-value:
    $ref: /schemas/types.yaml#/definitions/uint32
    description:
      Per-board correction of both the current and the charge the gauge
      reports, in percent. 100 means no correction.
    default: 100

  mediatek,ocv2cv-transform:
    type: boolean
    description:
      Correct the coulomb-counted state of charge for the load actually
      drawn, by shrinking the capacity tables in proportion to the average
      current over mediatek,cv-current-microamp. Present when the pack has
      been characterised well enough for that to help; it also makes the
      value kept over a reboot the uncorrected one.

  mediatek,step-of-qmax-microamp-hours:
    description: Step used when searching the maximum capacity for a load.
    default: 54000

  mediatek,cv-current-microamp:
    description:
      The load the pack was characterised at. The meter scales its capacity
      tables by the ratio of the measured average current to this. It is not
      the charger's termination current, which is charge-term-current-microamp
      of the monitored battery.
    default: 600000

  mediatek,poweron-low-capacity-tolerance:
    $ref: /schemas/types.yaml#/definitions/uint32
    description:
      State of charge in percent below which the value remembered from the
      previous boot is not trusted unless a charger is present.
    default: 0

  mediatek,qmax-microamp-hours:
    description:
      Capacity of the pack at each temperature in ocv-capacity-celsius, drawn
      at the characterisation current.
    minItems: 1
    maxItems: 20

  mediatek,qmax-high-current-microamp-hours:
    description:
      Capacity of the pack at each temperature in ocv-capacity-celsius, drawn
      at the highest current it was characterised at. Defaults to
      mediatek,qmax-microamp-hours.
    minItems: 1
    maxItems: 20

patternProperties:
  "^mediatek,ocv-resistance-table-[0-9]+$":
    $ref: /schemas/types.yaml#/definitions/uint32-matrix
    description:
      The internal resistance of the pack at each point of the battery's
      ocv-capacity-table with the same index, in the same order and with the
      same number of points. battery.yaml has no property for it, because
      resistance-temp-table scales a single resistance with temperature,
      while this one also varies along the discharge curve.
    maxItems: 128
    items:
      items:
        - description: open circuit voltage in microvolts
        - description: internal resistance in microohms

required:
  - compatible
  - io-channels
  - io-channel-names
  - monitored-battery
  - nvmem-cells
  - nvmem-cell-names
  - shunt-resistor-micro-ohms
  - mediatek,qmax-microamp-hours
  - mediatek,ocv-resistance-table-0

additionalProperties: false

examples:
  - |
    pmic {
        battery {
            compatible = "mediatek,mt6397-battery";
            io-channels = <&pmic_auxadc 0>;
            io-channel-names = "voltage";
            monitored-battery = <&pack>;
            nvmem-cells = <&rtc_soc>;
            nvmem-cell-names = "state-of-charge";
            power-supplies = <&charger>;
            shunt-resistor-micro-ohms = <10000>;
            mediatek,car-tune-value = <101>;
            mediatek,cv-current-microamp = <600000>;
            mediatek,ocv2cv-transform;
            mediatek,ocv-resistance-table-0 =
                <4275000 130000>, <3831000 110000>, <3352000 170000>;
            mediatek,qmax-microamp-hours = <6348000>;
            mediatek,qmax-high-current-microamp-hours = <6130000>;
            mediatek,step-of-qmax-microamp-hours = <54000>;
        };
    };
```

## Documentation/devicetree/bindings/soc/mediatek/mediatek,mt8173-spm-suspend.yaml
```yaml
# SPDX-License-Identifier: (GPL-2.0-only OR BSD-2-Clause)
%YAML 1.2
---
$id: http://devicetree.org/schemas/soc/mediatek/mediatek,mt8173-spm-suspend.yaml#
$schema: http://devicetree.org/meta-schemas/core.yaml#

title: MediaTek MT8173 System Power Manager suspend-to-RAM

maintainers:
  - Ryan Brue <ryanbrue.dev@gmail.com>

description:
  The MT8173 System Power Manager (SPM) is a small sequencer inside the SCPSYS
  block that takes the SoC into and out of suspend-to-RAM once every CPU is
  in WFI. On boards that ship ARM Trusted Firmware this is driven from EL3
  through PSCI SYSTEM_SUSPEND; boards whose firmware predates PSCI 1.0 have
  to drive the SPM from the kernel. This node describes that case and is a
  child of the SCPSYS syscon, whose registers it uses. Boards with ARM
  Trusted Firmware must not have it.

properties:
  compatible:
    const: mediatek,mt8173-spm-suspend

  interrupts:
    maxItems: 1
    description: SPM IRQ0

  clocks:
    items:
      - description: the SCP clock mux (scp_sel)
      - description: the mux's normal parent (syspll1_d2)
      - description: the 26 MHz crystal (clk26m)
    description:
      The SCP clock is parked on the crystal for the duration of a suspend,
      because the SPM stops the PLL it normally runs from.

  clock-names:
    items:
      - const: scp_sel
      - const: syspll1_d2
      - const: clk26m

  mediatek,mcucfg:
    $ref: /schemas/types.yaml#/definitions/phandle
    description:
      The MCUCFG syscon, whose ACINACTM bits are asserted around the WFI so
      the clusters report themselves idle to the SPM.

  mediatek,pmic:
    $ref: /schemas/types.yaml#/definitions/phandle
    description:
      The MT6397 PMIC. Its CPU and core rail hold bits are cleared for the
      duration of the suspend so those rails do not follow SRCLKEN down while
      the CPU stays powered.

required:
  - compatible
  - mediatek,mcucfg
  - mediatek,pmic

additionalProperties: false

examples:
  - |
    #include <dt-bindings/interrupt-controller/arm-gic.h>
    #include <dt-bindings/interrupt-controller/irq.h>
    #include <dt-bindings/clock/mt8173-clk.h>

    syscon@10006000 {
        compatible = "mediatek,mt8173-scpsys", "syscon", "simple-mfd";
        reg = <0x10006000 0x1000>;

        spm-suspend {
            compatible = "mediatek,mt8173-spm-suspend";
            clocks = <&topckgen CLK_TOP_SCP_SEL>,
                     <&topckgen CLK_TOP_SYSPLL1_D2>,
                     <&clk26m>;
            clock-names = "scp_sel", "syspll1_d2", "clk26m";
            interrupts = <GIC_SPI 155 IRQ_TYPE_LEVEL_LOW>;
            mediatek,mcucfg = <&mcucfg>;
            mediatek,pmic = <&pmic>;
        };
    };
```

## Documentation/devicetree/bindings/sound/mediatek,mt8173-mt6391.yaml
```yaml
# SPDX-License-Identifier: (GPL-2.0-only OR BSD-2-Clause)
%YAML 1.2
---
$id: http://devicetree.org/schemas/sound/mediatek,mt8173-mt6391.yaml#
$schema: http://devicetree.org/meta-schemas/core.yaml#

title: MediaTek MT8173 with the MT6391 PMIC audio codec

maintainers:
  - Ryan Brue <ryanbrue.dev@gmail.com>

description:
  Sound card for MT8173 boards whose playback codec is the audio block of the
  MT6391 PMIC, an MT6397 variant, reached over the SoC's internal ADDA
  interface. Capture, when fitted, comes from a Realtek RT5514 on the I2S
  interface.

properties:
  compatible:
    const: mediatek,mt8173-mt6391

  mediatek,audio-codec:
    $ref: /schemas/types.yaml#/definitions/phandle-array
    description:
      The audio codec node of the PMIC, then, when fitted, the RT5514
      carrying the microphone on I2S.
    minItems: 1
    maxItems: 2

  mediatek,platform:
    $ref: /schemas/types.yaml#/definitions/phandle
    description: The MT8173 audio front end (AFE).

required:
  - compatible
  - mediatek,audio-codec
  - mediatek,platform

additionalProperties: false

examples:
  - |
    sound {
        compatible = "mediatek,mt8173-mt6391";
        mediatek,audio-codec = <&mt6397_codec>, <&rt5514>;
        mediatek,platform = <&afe>;
    };
...
```

## Documentation/devicetree/bindings/sound/samsung,espresso-audio.yaml
```yaml
# SPDX-License-Identifier: (GPL-2.0-only OR BSD-2-Clause)
%YAML 1.2
---
$id: http://devicetree.org/schemas/sound/samsung,espresso-audio.yaml#
$schema: http://devicetree.org/meta-schemas/core.yaml#

title: Samsung Galaxy Tab 2 (espresso) audio complex with WM1811 codec

maintainers:
  - Ryan Brue <ryanbrue.dev@gmail.com>

description:
  The Samsung Galaxy Tab 2 7.0 and 10.1 (espresso) tablets have a WM1811 codec
  on McBSP3 of the OMAP4430. The codec provides the bit and frame clocks and
  runs its FLL from MCLK1. The main and headset microphones have their mic
  bias switched by GPIOs.

allOf:
  - $ref: sound-card-common.yaml#

properties:
  compatible:
    const: samsung,espresso-audio

  cpu:
    type: object
    additionalProperties: false
    properties:
      sound-dai:
        maxItems: 1
        description: phandle to the McBSP
    required:
      - sound-dai

  codec:
    type: object
    additionalProperties: false
    properties:
      sound-dai:
        maxItems: 1
        description: phandle to the WM1811 codec
    required:
      - sound-dai

  audio-routing:
    description:
      List of the connections between audio components; each entry is a pair
      of strings, the first being the connection's sink, the second being the
      connection's source; valid names for sources and sinks are the WM1811's
      pins (as documented in its binding), and the jacks on the board, HP,
      SPK, RCV, LINE, Main Mic and Headset Mic.

  mic-bias-supply:
    description: Supply for the mic bias of the main microphone

  headset-mic-bias-supply:
    description: Supply for the mic bias of the headset microphone

required:
  - compatible
  - model
  - cpu
  - codec
  - audio-routing

unevaluatedProperties: false

examples:
  - |
    sound {
        compatible = "samsung,espresso-audio";
        model = "GalaxyTab2";

        mic-bias-supply = <&main_mic_bias>;
        headset-mic-bias-supply = <&ear_mic_bias>;

        audio-routing =
            "HP", "HPOUT1L",
            "HP", "HPOUT1R",
            "SPK", "SPKOUTLN",
            "SPK", "SPKOUTLP",
            "SPK", "SPKOUTRN",
            "SPK", "SPKOUTRP",
            "IN1LP", "Main Mic",
            "IN1LN", "Main Mic",
            "IN1RP", "Headset Mic",
            "IN1RN", "Headset Mic",
            "Headset Mic", "MICBIAS2";

        cpu {
            sound-dai = <&mcbsp3>;
        };

        codec {
            sound-dai = <&wm1811>;
        };
    };
```

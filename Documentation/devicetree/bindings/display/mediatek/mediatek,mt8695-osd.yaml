## Documentation/devicetree/bindings/display/mediatek/mediatek,mt8695-osd.yaml
```yaml
# SPDX-License-Identifier: (GPL-2.0-only OR BSD-2-Clause)
%YAML 1.2
---
$id: http://devicetree.org/schemas/display/mediatek/mediatek,mt8695-osd.yaml#
$schema: http://devicetree.org/meta-schemas/core.yaml#

title: MediaTek MT8695 OSD Plane

maintainers:
  - Ryan Brue <ryanbrue.dev@gmail.com>

description:
  The on-screen display (OSD) of the MediaTek MT8695 TV SoC has two
  graphics planes, FHD and UHD, each with its own timing, plane and scaler
  registers. A plane reads region headers and buffers from memory through
  the M4U and feeds one input of the VDOUT premix, which stacks the UHD
  plane above the FHD plane.

properties:
  compatible:
    enum:
      - mediatek,mt8695-osd-fhd
      - mediatek,mt8695-osd-uhd

  reg:
    maxItems: 1

  interrupts:
    items:
      - description: The plane's vertical sync

  power-domains:
    maxItems: 1

  clocks:
    items:
      - description: OSD clock mux
      - description: The plane's clock

  clock-names:
    items:
      - const: osd
      - const: plane

  iommus:
    maxItems: 1

  memory-region:
    maxItems: 1
    description:
      The bootloader's framebuffer, still scanned out on this plane when
      the operating system starts.

  port:
    $ref: /schemas/graph.yaml#/properties/port
    description: Output to the VDOUT premix

required:
  - compatible
  - reg
  - power-domains
  - clocks
  - clock-names
  - iommus
  - port

additionalProperties: false

examples:
  - |
    #include <dt-bindings/clock/mediatek,mt8695-clk.h>
    #include <dt-bindings/interrupt-controller/arm-gic.h>
    #include <dt-bindings/memory/mediatek,mt8695-memory-port.h>
    #include <dt-bindings/power/mediatek,mt8695-power.h>

    osd@14003000 {
        compatible = "mediatek,mt8695-osd-fhd";
        reg = <0x14003000 0x300>;
        interrupts = <GIC_SPI 190 IRQ_TYPE_LEVEL_LOW>;
        power-domains = <&spm MT8695_POWER_DOMAIN_MM>;
        clocks = <&topckgen CLK_TOP_OSD_SEL>, <&mmsys CLK_MM_OSD_FHD>;
        clock-names = "osd", "plane";
        iommus = <&iommu M4U_PORT_FHD_OSD>;

        port {
            endpoint {
                remote-endpoint = <&vdout_in_fhd>;
            };
        };
    };
```

## Documentation/devicetree/bindings/display/mediatek/mediatek,mt8695-vdo.yaml
```yaml
# SPDX-License-Identifier: (GPL-2.0-only OR BSD-2-Clause)
%YAML 1.2
---
$id: http://devicetree.org/schemas/display/mediatek/mediatek,mt8695-vdo.yaml#
$schema: http://devicetree.org/meta-schemas/core.yaml#

title: MediaTek MT8695 Video Plane

maintainers:
  - Ryan Brue <ryanbrue.dev@gmail.com>

description:
  The MediaTek MT8695 TV SoC has two video planes, main and sub, below
  the OSD planes. Each one reads a two-plane YCbCr picture (luma, then
  interleaved chroma) through the M4U, scales it vertically in its VDO
  core and horizontally in its own formatter, and feeds one input of the
  VDOUT mixer. Its page holds the formatter, the DMA front end (UFOD)
  and the VDO core. The plane's reset, bus priority and output select
  are in the dispsys.

properties:
  compatible:
    enum:
      - mediatek,mt8695-vdo-main
      - mediatek,mt8695-vdo-sub

  reg:
    maxItems: 1

  power-domains:
    maxItems: 1

  clocks:
    items:
      - description: The VDO core's clock
      - description: The plane formatter's clock
      - description: The VDO clock mux

  clock-names:
    items:
      - const: vdo
      - const: fmt
      - const: sel

  iommus:
    minItems: 6
    maxItems: 10

  mediatek,dispsys:
    $ref: /schemas/types.yaml#/definitions/phandle
    description:
      The dispsys, which holds the plane's reset, bus priority and output
      select.

  port:
    $ref: /schemas/graph.yaml#/properties/port
    description: Output to the VDOUT mixer

required:
  - compatible
  - reg
  - power-domains
  - clocks
  - clock-names
  - iommus
  - mediatek,dispsys
  - port

allOf:
  - if:
      properties:
        compatible:
          contains:
            const: mediatek,mt8695-vdo-main
    then:
      properties:
        iommus:
          minItems: 10
    else:
      properties:
        iommus:
          maxItems: 6

additionalProperties: false

examples:
  - |
    #include <dt-bindings/clock/mediatek,mt8695-clk.h>
    #include <dt-bindings/memory/mediatek,mt8695-memory-port.h>
    #include <dt-bindings/power/mediatek,mt8695-power.h>

    video-plane@15008000 {
        compatible = "mediatek,mt8695-vdo-sub";
        reg = <0x15008000 0x1000>;
        power-domains = <&spm MT8695_POWER_DOMAIN_DIS_S>;
        clocks = <&dispsys CLK_DISP_VDO4>, <&dispsys CLK_DISP_FMT4>,
                 <&topckgen CLK_TOP_VDO4_SEL>;
        clock-names = "vdo", "fmt", "sel";
        iommus = <&iommu M4U_PORT_VDO4_UFOD_Y_LENGTH>,
                 <&iommu M4U_PORT_VDO4_UFOD_C_LENGTH>,
                 <&iommu M4U_PORT_VDO4_UFOD_Y1>,
                 <&iommu M4U_PORT_VDO4_UFOD_C1>,
                 <&iommu M4U_PORT_VDO4_UFOD_Y2>,
                 <&iommu M4U_PORT_VDO4_UFOD_C2>;
        mediatek,dispsys = <&dispsys>;

        port {
            endpoint {
                remote-endpoint = <&vdout_in_vdo_sub>;
            };
        };
    };
```

## Documentation/devicetree/bindings/display/mediatek/mediatek,mt8695-vdout.yaml
```yaml
# SPDX-License-Identifier: (GPL-2.0-only OR BSD-2-Clause)
%YAML 1.2
---
$id: http://devicetree.org/schemas/display/mediatek/mediatek,mt8695-vdout.yaml#
$schema: http://devicetree.org/meta-schemas/core.yaml#

title: MediaTek MT8695 VDOUT Display Output

maintainers:
  - Ryan Brue <ryanbrue.dev@gmail.com>

description:
  VDOUT is the display output of the MediaTek MT8695 TV SoC. Its format
  timing generator (FMT) makes the video timings; the premix in front of it
  mixes the OSD planes and a video plane, the OSD path's HDR block converts
  the mix, and RGB2HDMI behind the FMT converts the output for the HDMI
  transmitter. The FHD and UHD OSD planes come in through ports 0 and 1,
  the HDMI transmitter is on port 2.

properties:
  compatible:
    const: mediatek,mt8695-vdout

  reg:
    items:
      - description: FMT, VDOUT system, RGB2HDMI and premix registers
      - description: The OSD path's HDR block (BT.2020 and SDR to HDR)

  reg-names:
    items:
      - const: vdout
      - const: hdr

  interrupts:
    items:
      - description: FMT vertical sync
      - description: FMT active area start

  power-domains:
    maxItems: 1

  clocks:
    items:
      - description: HD pixel clock mux
      - description: VDOUT system clock
      - description: FMT timing generator clock
      - description: OSD premix clock
      - description: RGB2HDMI clock
      - description: SDR to HDR clock, for the HDR block
      - description: TVDPLL, the source of the pixel clock

  clock-names:
    items:
      - const: hd
      - const: vdout
      - const: fmt
      - const: premix
      - const: rgb2hdmi
      - const: sdr2hdr
      - const: tvdpll

  resets:
    maxItems: 1

  reset-names:
    items:
      - const: rgb2hdmi

  mediatek,mmsys:
    $ref: /schemas/types.yaml#/definitions/phandle
    description:
      The MMSYS system controller, which holds the HDMI reference clock
      selection.

  ports:
    $ref: /schemas/graph.yaml#/properties/ports

    properties:
      port@0:
        $ref: /schemas/graph.yaml#/properties/port
        description: Input from the FHD OSD plane

      port@1:
        $ref: /schemas/graph.yaml#/properties/port
        description: Input from the UHD OSD plane

      port@2:
        $ref: /schemas/graph.yaml#/properties/port
        description: Output to the HDMI transmitter

      port@3:
        $ref: /schemas/graph.yaml#/properties/port
        description: Input from the main video plane

      port@4:
        $ref: /schemas/graph.yaml#/properties/port
        description: Input from the sub video plane

    required:
      - port@0
      - port@2

required:
  - compatible
  - reg
  - reg-names
  - interrupts
  - power-domains
  - clocks
  - clock-names
  - resets
  - reset-names
  - mediatek,mmsys
  - ports

additionalProperties: false

examples:
  - |
    #include <dt-bindings/clock/mediatek,mt8695-clk.h>
    #include <dt-bindings/interrupt-controller/arm-gic.h>
    #include <dt-bindings/power/mediatek,mt8695-power.h>

    display-controller@14001000 {
        compatible = "mediatek,mt8695-vdout";
        reg = <0x14001000 0x1000>, <0x14002000 0x1000>;
        reg-names = "vdout", "hdr";
        interrupts = <GIC_SPI 185 IRQ_TYPE_LEVEL_LOW>,
                     <GIC_SPI 186 IRQ_TYPE_LEVEL_LOW>;
        power-domains = <&spm MT8695_POWER_DOMAIN_MM>;
        clocks = <&topckgen CLK_TOP_HD_SEL>,
                 <&mmsys CLK_MM_VDOUT>,
                 <&mmsys CLK_MM_FMT_TG>,
                 <&mmsys CLK_MM_OSD_PREMIX>,
                 <&mmsys CLK_MM_RGB2HDMI>,
                 <&mmsys CLK_MM_OSD_SDR2HDR>,
                 <&apmixedsys CLK_APMIXED_TVDPLL>;
        clock-names = "hd", "vdout", "fmt", "premix", "rgb2hdmi", "sdr2hdr",
                      "tvdpll";
        resets = <&mmsys 9>;
        reset-names = "rgb2hdmi";
        mediatek,mmsys = <&mmsys>;

        ports {
            #address-cells = <1>;
            #size-cells = <0>;

            port@0 {
                reg = <0>;

                endpoint {
                    remote-endpoint = <&osd_fhd_out>;
                };
            };

            port@1 {
                reg = <1>;

                endpoint {
                    remote-endpoint = <&osd_uhd_out>;
                };
            };

            port@2 {
                reg = <2>;

                endpoint {
                    remote-endpoint = <&hdmi_in>;
                };
            };
        };
    };
```

## Documentation/devicetree/bindings/media/cec/mediatek,mt8695-cec.yaml
```yaml
# SPDX-License-Identifier: (GPL-2.0-only OR BSD-2-Clause)
%YAML 1.2
---
$id: http://devicetree.org/schemas/media/cec/mediatek,mt8695-cec.yaml#
$schema: http://devicetree.org/meta-schemas/core.yaml#

title: MediaTek MT8695 HDMI CEC controller

maintainers:
  - Ryan Brue <ryanbrue.dev@gmail.com>

description:
  The second-generation HDMI CEC controller of the MediaTek MT8695. It
  handles message framing, up to three logical addresses and
  retransmission in hardware. The SoC also has the first-generation CEC
  block, which selects which of the two drives the CEC pin, so the
  controller needs that block's registers too.

allOf:
  - $ref: cec-common.yaml#

properties:
  compatible:
    const: mediatek,mt8695-cec

  reg:
    items:
      - description: CEC controller registers
      - description: first-generation CEC block registers

  reg-names:
    items:
      - const: cec
      - const: legacy

  interrupts:
    maxItems: 1

  clocks:
    maxItems: 1

required:
  - compatible
  - reg
  - reg-names
  - interrupts
  - clocks
  - hdmi-phandle

unevaluatedProperties: false

examples:
  - |
    #include <dt-bindings/clock/mediatek,mt8695-clk.h>
    #include <dt-bindings/interrupt-controller/arm-gic.h>
    #include <dt-bindings/interrupt-controller/irq.h>

    cec@10002400 {
        compatible = "mediatek,mt8695-cec";
        reg = <0x10002400 0x100>, <0x10002000 0x100>;
        reg-names = "cec", "legacy";
        interrupts = <GIC_SPI 175 IRQ_TYPE_LEVEL_LOW>;
        clocks = <&infracfg CLK_INFRA_CEC>;
        hdmi-phandle = <&hdmi>;
    };
```

## Documentation/devicetree/bindings/regulator/mediatek,mt6393-regulator.yaml
```yaml
# SPDX-License-Identifier: (GPL-2.0-only OR BSD-2-Clause)
%YAML 1.2
---
$id: http://devicetree.org/schemas/regulator/mediatek,mt6393-regulator.yaml#
$schema: http://devicetree.org/meta-schemas/core.yaml#

title: MediaTek MT6393 Regulator

maintainers:
  - Ryan Brue <ryanbrue.dev@gmail.com>

description:
  The MediaTek MT6393 is an I2C power management IC with four step-down
  converters and one low-dropout regulator. Only the first converter, VPROC,
  is adjustable (600 mV to 1.39375 V in 6.25 mV steps); VDDR (1.1 V), VIO18
  (1.8 V), VIO33 (3.3 V) and the VSD LDO (3.3 V) have fixed outputs and can
  only be switched on and off.

properties:
  compatible:
    const: mediatek,mt6393-regulator

  reg:
    description: I2C slave address.
    maxItems: 1

  regulators:
    type: object
    description: List of regulators provided by this controller.

    properties:
      ldo-vsd:
        type: object
        $ref: regulator.yaml#
        unevaluatedProperties: false

    patternProperties:
      "^buck-(vproc|vddr|vio18|vio33)$":
        type: object
        $ref: regulator.yaml#
        unevaluatedProperties: false

    additionalProperties: false

required:
  - compatible
  - reg
  - regulators

additionalProperties: false

examples:
  - |
    i2c {
      #address-cells = <1>;
      #size-cells = <0>;

      pmic@60 {
        compatible = "mediatek,mt6393-regulator";
        reg = <0x60>;

        regulators {
          buck-vproc {
            regulator-name = "vproc";
            regulator-min-microvolt = <800000>;
            regulator-max-microvolt = <1100000>;
            regulator-ramp-delay = <5000>;
            regulator-always-on;
          };

          buck-vio18 {
            regulator-name = "vio18";
            regulator-always-on;
          };
        };
      };
    };
...
```

## Documentation/devicetree/bindings/sound/mediatek,mt8695-audio.yaml
```yaml
# SPDX-License-Identifier: (GPL-2.0-only OR BSD-2-Clause)
%YAML 1.2
---
$id: http://devicetree.org/schemas/sound/mediatek,mt8695-audio.yaml#
$schema: http://devicetree.org/meta-schemas/core.yaml#

title: MediaTek MT8695 Audio Front End (AFE)

maintainers:
  - Ryan Brue <ryanbrue.dev@gmail.com>

description:
  The MT8695 AFE moves PCM data between memory and the audio interfaces,
  among them an 8-channel I2S engine wired to the on-chip HDMI
  transmitter. It shares its registers with the audsys clock controller
  and must be a subnode of the mediatek,mt8695-audsys node.

properties:
  compatible:
    const: mediatek,mt8695-audio

  interrupts:
    items:
      - description: AFE interrupt
      - description: ASYS interrupt

  interrupt-names:
    items:
      - const: afe
      - const: asys

  clocks:
    items:
      - description: AFE gate
      - description: AFE interconnect gate
      - description: A1SYS gate, the 48 kHz family
      - description: A2SYS gate, the 44.1 kHz family
      - description: APLL gate
      - description: HDMI output gate
      - description: APLL1 mux, the 48 kHz family root
      - description: APLL2 mux, the 44.1 kHz family root

  clock-names:
    items:
      - const: afe
      - const: afe_conn
      - const: a1sys
      - const: a2sys
      - const: apll
      - const: hdmi
      - const: apll1
      - const: apll2

required:
  - compatible
  - interrupts
  - interrupt-names
  - clocks
  - clock-names

additionalProperties: false

examples:
  - |
    #include <dt-bindings/clock/mediatek,mt8695-clk.h>
    #include <dt-bindings/interrupt-controller/arm-gic.h>
    #include <dt-bindings/interrupt-controller/irq.h>

    audio-controller {
        compatible = "mediatek,mt8695-audio";
        interrupts = <GIC_SPI 242 IRQ_TYPE_LEVEL_LOW>,
                     <GIC_SPI 142 IRQ_TYPE_LEVEL_LOW>;
        interrupt-names = "afe", "asys";
        clocks = <&audsys CLK_AUD_AFE>,
                 <&audsys CLK_AUD_AFE_CONN>,
                 <&audsys CLK_AUD_A1SYS>,
                 <&audsys CLK_AUD_A2SYS>,
                 <&audsys CLK_AUD_APLL>,
                 <&audsys CLK_AUD_HDMI>,
                 <&topckgen CLK_TOP_APLL_SEL>,
                 <&topckgen CLK_TOP_APLL2_SEL>;
        clock-names = "afe", "afe_conn", "a1sys", "a2sys",
                      "apll", "hdmi", "apll1", "apll2";
    };
```
